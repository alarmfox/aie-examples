## partition-nopl/petalinux-bpf/project-spec/configs/configs/Kconfig
```kconfig
mainmenu "PetaLinux System Configuration"
config SUBSYSTEM_TYPE_LINUX
        bool
        default y
        select SYSTEM_VERSAL

config SYSTEM_VERSAL
        bool "VERSAL Configuration"
        help
          VERSAL Configuration for the project.
          All these config options will be in /home/alarmfox/src/aie-examples/partition-nopl/petalinux-bpf/project-spec/configs/config

config SUBSYSTEM_VARIANT_VERSALAI-EDGE
        bool
        default y
        help

config SUBSYSTEM_SDT_FLOW
        bool
        default y
        help

config SUBSYSTEM_DISTRO_PETALINUX
        bool
        default y
        help

source /home/alarmfox/src/aie-examples/partition-nopl/petalinux-bpf/project-spec/configs/configs/Kconfig.main
```

## partition-nopl/petalinux-bpf/project-spec/configs/rootfsconfigs/Kconfig.user
```kconfig
menu "user packages " 
config libvdu-ctrlsw  
	 bool "libvdu-ctrlsw"
	 help
	
config libvdu-omxil  
	 bool "libvdu-omxil"
	 help
	
config aie-notebooks  
	 bool "aie-notebooks"
	 help
	
config aie-oob  
	 bool "aie-oob"
	 help
	
config bpftool  
	 bool "bpftool"
	 help
	
config gpio-demo  
	 bool "gpio-demo"
	 help
	
config gstreamer-vdu-examples  
	 bool "gstreamer-vdu-examples"
	 help
	
config gstreamer-vdu-notebooks  
	 bool "gstreamer-vdu-notebooks"
	 help
	
config kernel-module-vdu  
	 bool "kernel-module-vdu"
	 help
	
config openamp-demo-notebooks  
	 bool "openamp-demo-notebooks"
	 help
	
config packagegroup-xilinx-gstreamer  
	 bool "packagegroup-xilinx-gstreamer"
	 help
	
config packagegroup-xilinx-jupyter  
	 bool "packagegroup-xilinx-jupyter"
	 help
	
config peekpoke  
	 bool "peekpoke"
	 help
	
config pm-notebooks  
	 bool "pm-notebooks"
	 help
	
config python3-ipywidgets  
	 bool "python3-ipywidgets"
	 help
	
config vdu-ctrlsw  
	 bool "vdu-ctrlsw"
	 help
	
config vdu-firmware  
	 bool "vdu-firmware"
	 help
	
endmenu
```
